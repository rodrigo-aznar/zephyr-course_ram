## app/drivers/my_driver/Kconfig
```kconfig
config MY_DRIVER
    bool "Custom Driver ENABLE"
    default y
    help
        enable/disable the custom driver
```

## twister-out/native_sim_native/host_gnu/zephyr-course_ram/tests/ring_buf/homework.unit.ring_buf/Kconfig/arch/Kconfig
```kconfig
# Load Zephyr Arch Kconfig descriptions.
osource "/home/rodrigo/zephyrproject/zephyr/arch/rx/Kconfig"
osource "/home/rodrigo/zephyrproject/zephyr/arch/x86/Kconfig"
osource "/home/rodrigo/zephyrproject/zephyr/arch/xtensa/Kconfig"
osource "/home/rodrigo/zephyrproject/zephyr/arch/sparc/Kconfig"
osource "/home/rodrigo/zephyrproject/zephyr/arch/riscv/Kconfig"
osource "/home/rodrigo/zephyrproject/zephyr/arch/posix/Kconfig"
osource "/home/rodrigo/zephyrproject/zephyr/arch/openrisc/Kconfig"
osource "/home/rodrigo/zephyrproject/zephyr/arch/mips/Kconfig"
osource "/home/rodrigo/zephyrproject/zephyr/arch/arm64/Kconfig"
osource "/home/rodrigo/zephyrproject/zephyr/arch/arm/Kconfig"
osource "/home/rodrigo/zephyrproject/zephyr/arch/arc/Kconfig"
```

## twister-out/native_sim_native/host_gnu/zephyr-course_ram/tests/ring_buf/homework.unit.ring_buf/Kconfig/boards/Kconfig
```kconfig
# Load Zephyr board Kconfig descriptions.
osource "/home/rodrigo/zephyrproject/zephyr/boards/native/native_sim/Kconfig"
```

## twister-out/native_sim_native/host_gnu/zephyr-course_ram/tests/ring_buf/homework.unit.ring_buf/Kconfig/boards/Kconfig.defconfig.tmp
```kconfig
# Load Zephyr board defconfig descriptions.
osource "/home/rodrigo/zephyrproject/zephyr/boards/native/native_sim/Kconfig.defconfig"
```

## twister-out/native_sim_native/host_gnu/zephyr-course_ram/tests/ring_buf/homework.unit.ring_buf/Kconfig/boards/Kconfig.native_sim.tmp
```kconfig
# Load board Kconfig descriptions.
osource "/home/rodrigo/zephyrproject/zephyr/boards/native/native_sim/Kconfig.native_sim"
```

## twister-out/native_sim_native/host_gnu/zephyr-course_ram/tests/ring_buf/homework.unit.ring_buf/Kconfig/boards/Kconfig.sysbuild.tmp
```kconfig
# Load Sysbuild board Kconfig descriptions.
osource "/home/rodrigo/zephyrproject/zephyr/boards/native/native_sim/Kconfig.sysbuild"
```
