## app/boards/esp32_3248S035C/Kconfig.esp32_3248S035C
```kconfig
config BOARD_ESP32_3248S035C
	select SOC_ESP32_WROVER_E_N4R8
	select SOC_ESP32_PROCPU if BOARD_ESP32_3248S035C_ESP32_PROCPU
```

## app/boards/esp32_3248S035C/board.yml
```yaml
board:
  name: esp32_3248S035C
  full_name: ESP32-3248S035C from scratch
  vendor: DIYmalls
  socs:
  - name: esp32
```
